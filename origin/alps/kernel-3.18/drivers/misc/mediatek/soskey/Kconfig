## origin/alps/kernel-3.18/drivers/misc/mediatek/soskey/Kconfig
```kconfig
config LY_GPIO_SOSKEY_SUPPORT
	tristate "GPIO soskey support"
	depends on GPIOLIB
	help
	  Say Y here to enable GPIO based soskey support.
```
